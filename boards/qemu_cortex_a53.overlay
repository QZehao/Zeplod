/*
 * Copyright (c) 2026
 * SPDX-License-Identifier: GPL-3.0
 *
 * qemu_cortex_a53 设备树覆盖（QEMU 仿真）
 * Note: ARM64, PCIe available
 */

/ {
	aliases {
	};

};

&uart0 {
	status = "okay";
	current-speed = <115200>;
};
