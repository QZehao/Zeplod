/*
 * Copyright (c) 2026
 * SPDX-License-Identifier: GPL-3.0
 *
 * qemu_x86_tiny 设备树覆盖（QEMU 仿真）
 * Note: x86 tiny, 256KB DRAM
 */

/ {
	aliases {
	};

};

&uart0 {
	status = "okay";
	current-speed = <115200>;
};
