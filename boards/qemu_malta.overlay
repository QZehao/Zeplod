/*
 * Copyright (c) 2026
 * SPDX-License-Identifier: GPL-3.0
 *
 * qemu_malta 设备树覆盖（QEMU 仿真）
 * Note: MIPS malta, console on uart2
 */

/ {
	aliases {
	};

};

&uart2 {
	status = "okay";
	current-speed = <115200>;
};
