/*
 * Copyright (c) 2026
 * SPDX-License-Identifier: GPL-3.0
 *
 * qemu_arc_qemu_arc_em 设备树覆盖（QEMU 仿真）
 * Note: ARC EM, ns16550 uart
 */

/ {
	aliases {
	};

};

&ns16550_uart0 {
	status = "okay";
	current-speed = <115200>;
};

