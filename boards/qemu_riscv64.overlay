/*
 * Copyright (c) 2026
 * SPDX-License-Identifier: GPL-3.0
 *
 * qemu_riscv64 设备树覆盖（QEMU 仿真）
 * Note: RISC-V 64-bit virt
 */

/ {
	aliases {
	};

};

&uart0 {
	status = "okay";
	current-speed = <115200>;
};
