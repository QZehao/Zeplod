/*
 * Copyright (c) 2026
 * SPDX-License-Identifier: Apache-2.0
 */

/*
 * Sample device tree overlay for zephyr_template
 * 
 * This file can be used to customize the device tree for your specific board.
 * Add or modify nodes as needed for your hardware configuration.
 */

/ {
    /* Example: Add an LED alias */
    aliases {
        led0 = &led0;
    };

    /* Example: Add a button alias */
    aliases {
        button0 = &button0;
    };
};

/* Example: Configure GPIO LEDs */
&gpio0 {
    status = "okay";
};

/* Example: Configure UART console */
&uart0 {
    status = "okay";
    current-speed = <115200>;
};

/* 
 * Example: Add a sample sensor node
 * Uncomment and modify for your hardware
 */
/*
&i2c0 {
    status = "okay";
    
    sensor_example: sensor@40 {
        compatible = "vendor,sensor-model";
        reg = <0x40>;
        interrupt-parent = <&gpio0>;
        interrupts = <5 IRQ_TYPE_EDGE_FALLING>;
    };
};
*/

/*
 * Example: Add a sample SPI device
 */
/*
&spi0 {
    status = "okay";
    cs-gpios = <&gpio0 4 GPIO_ACTIVE_LOW>;
    
    device_example: device@0 {
        compatible = "vendor,device-model";
        reg = <0>;
        spi-max-frequency = <10000000>;
    };
};
*/
