/* STM32L4R5ZI：zephyr,sram 扩展为 0x20000000 起 640KB 连续 SRAM（见 RM0432） */

/delete-node/ &sram0;
/delete-node/ &sram1;
/delete-node/ &sram2;

/ {
	sram0: memory@20000000 {
		/* 640 KiB */
		reg = <0x20000000 0xA0000>;
	};
};
