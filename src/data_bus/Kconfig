## src/data_bus/Kconfig
```kconfig
menu "Data Bus (Standard)"

config DATA_BUS
    bool "Enable Data Bus module"
    default n
    help
      Named-channel, reference-counted stream data sharing.
      Completely independent from the event system.

config DATA_BUS_CHANNEL_NAME_MAX
    int "Maximum channel name length (including NUL terminator)"
    default 16
    range 8 64
    depends on DATA_BUS
    help
      Name buffer size used in channel creation, lookup, and
      event bridge notifications.
      Must match data_bus_event_notification_t::channel_name array size.

config DATA_BUS_MAX_CHANNELS
    int "Maximum number of channels"
    default 8
    range 1 64
    depends on DATA_BUS

config DATA_BUS_MAX_CONSUMERS_PER_CHANNEL
    int "Maximum consumers per channel"
    default 4
    range 1 32
    depends on DATA_BUS

config DATA_BUS_CHANNEL_QUEUE_DEPTH
    int "Channel queue depth (block pointer count)"
    default 16
    range 1 256
    depends on DATA_BUS

config DATA_BUS_MAX_BLOCKS
    int "Maximum concurrent blocks (data_bus_block_t slab size)"
    default 32
    range 1 256
    depends on DATA_BUS
    help
      Maximum number of data_bus_block_t structures in the system
      at any time. Should be >= total count of all data slab blocks
      to cover both slab and k_malloc fallback scenarios.

config DATA_BUS_DISPATCHER_STACK_SIZE
    int "Dispatcher thread stack size"
    default 2048
    range 512 8192
    depends on DATA_BUS

config DATA_BUS_DISPATCHER_PRIORITY
    int "Dispatcher thread priority"
    default 5
    range 0 15
    depends on DATA_BUS

config DATA_BUS_DEINIT_DRAIN_TIMEOUT_MS
    int "Deinit channel operation drain timeout (ms)"
    default 5000
    range 10 60000
    depends on DATA_BUS
    help
      Maximum time data_bus_deinit() waits for publishers, dispatcher work,
      and consumer unregister operations after the dispatcher thread exits.
      A timeout returns -EBUSY and leaves the bus shutting down so deinit can
      be retried without accepting new publishes.

config DATA_BUS_SLAB_ENABLE
    bool "Enable data bus slab pool"
    default y
    depends on DATA_BUS

config DATA_BUS_NO_MALLOC
    bool "Disallow k_malloc fallback for data buffers"
    default n
    depends on DATA_BUS && DATA_BUS_SLAB_ENABLE
    help
      When enabled, thread-context allocation behaves like the ISR path:
      slab exhaustion returns NULL and publish returns -ENOMEM.
      Recommended for hard real-time robot/motor control profiles.

config DATA_BUS_SLAB_64_COUNT
    int "64-byte slab block count"
    default 0
    range 0 256
    depends on DATA_BUS_SLAB_ENABLE

config DATA_BUS_SLAB_128_COUNT
    int "128-byte slab block count"
    default 0
    range 0 256
    depends on DATA_BUS_SLAB_ENABLE

config DATA_BUS_SLAB_256_COUNT
    int "256-byte slab block count"
    default 8
    range 0 256
    depends on DATA_BUS_SLAB_ENABLE

config DATA_BUS_SLAB_1K_COUNT
    int "1KB slab block count"
    default 4
    range 0 256
    depends on DATA_BUS_SLAB_ENABLE

config DATA_BUS_SLAB_512_COUNT
    int "512-byte slab block count"
    default 0
    range 0 256
    depends on DATA_BUS_SLAB_ENABLE

config DATA_BUS_SLAB_4K_COUNT
    int "4KB slab block count"
    default 2
    range 0 256
    depends on DATA_BUS_SLAB_ENABLE

config DATA_BUS_EVENT_BRIDGE
    bool "Bridge data bus notifications to event system"
    default y
    depends on DATA_BUS && EVENT_SYSTEM

config DATA_BUS_EVENT_TYPE_ID
    int "Event type ID for DATA_BUS_AVAILABLE bridge notifications"
    default 30
    range 0 255
    depends on DATA_BUS_EVENT_BRIDGE
    help
      Passed to event_publish_copy() from data_bus_event_bridge_notify().
      Must not collide with other application event types.

config DATA_BUS_FALLBACK_WARN_THRESHOLD
    int "k_malloc fallback warning threshold"
    default 0
    range 0 65535
    depends on DATA_BUS
    help
      Publish a Data Bus memory health warning after this many k_malloc
      fallback allocations on a channel. 0 disables event warning emission
      and preserves the existing logging-only behavior.

config DATA_BUS_HEALTH_EVENT_TYPE_ID
    int "Event type ID for Data Bus memory health warnings"
    default 31
    range 0 255
    depends on DATA_BUS_EVENT_BRIDGE && DATA_BUS_FALLBACK_WARN_THRESHOLD > 0
    help
      Passed to event_publish_copy() for DATA_BUS_MEMORY_WARNING events.
      Keep distinct from CONFIG_DATA_BUS_EVENT_TYPE_ID and application
      event type IDs.

config DATA_BUS_DEBUG_REFCNT
    bool "Debug: reference count assertions in destroy/deinit"
    default n
    depends on DATA_BUS
    help
      Check abnormal ref_count during channel_destroy and deinit
      to help locate unpaired release causing slab exhaustion.

config DATA_BUS_LOG_LEVEL
    int "Log level"
    default 3
    range 0 4
    depends on DATA_BUS
    help
      0=OFF, 1=ERROR, 2=WARNING, 3=INFO, 4=DEBUG
      Set to 0 or 1 for production to reduce code size.

endmenu
```

## src/modules/connectivity/Kconfig
```kconfig
menuconfig CONNECTIVITY_MODULE
	bool "Enable connectivity module"
	default n
	depends on EVENT_MAX_TYPES > 60
	help
	  Link up/down abstraction with pluggable backend.
	  Requires CONFIG_EVENT_MAX_TYPES > 60 (event ID 60).

if CONNECTIVITY_MODULE

config CONNECTIVITY_MODULE_AUTOINIT
	bool "Auto-register connectivity module at boot"
	default y

choice CONNECTIVITY_BACKEND
	prompt "Connectivity backend"
	default CONNECTIVITY_BACKEND_NULL
	help
	  Null backend synchronously simulates link up/down for ztest.
	  Wi-Fi backend can be added in Phase 4.

config CONNECTIVITY_BACKEND_NULL
	bool "Null (sync stub) backend"

endchoice

endif
```

## src/modules/factory/Kconfig
```kconfig
menuconfig FACTORY_MODE_MODULE
	bool "Enable factory mode module"
	default n
	depends on EVENT_MAX_TYPES > 70
	help
	  Production-line test mode: enter/exit, GPIO loopback stub,
	  calibration staging and commit to app_kv.
	  Requires CONFIG_EVENT_MAX_TYPES > 70 (event ID 70).

if FACTORY_MODE_MODULE

config FACTORY_MODE_MODULE_AUTOINIT
	bool "Auto-register factory mode module at boot"
	default y

config FACTORY_MODE_SHELL
	bool "Register factory shell commands"
	default y
	depends on SHELL

config FACTORY_MODE_GPIO_STUB
	bool "Use GPIO loopback stub (always pass)"
	default y
	help
	  Phase 4: synchronous stub for ztest and boards without loopback wiring.
	  Disable when adding real GPIO loopback backend.

config FACTORY_MODE_CAL_MAX_ENTRIES
	int "Max calibration entries in RAM staging"
	default 8
	range 1 32

config FACTORY_MODE_CAL_KEY_MAX_LEN
	int "Max calibration key length"
	default 24
	range 8 64

config FACTORY_MODE_CAL_VALUE_MAX_LEN
	int "Max calibration value length"
	default 64
	range 16 256

endif
```

## src/modules/feature_gate/Kconfig
```kconfig
menuconfig FEATURE_GATE_MODULE
	bool "Enable feature gate module (non-security license slots)"
	default n
	depends on EVENT_SYSTEM
	depends on EVENT_MAX_TYPES > 72
	help
	  Named feature slots unlocked by license token string match.
	  Event ID 72. Not a cryptographic DRM.

if FEATURE_GATE_MODULE

config FEATURE_GATE_MODULE_AUTOINIT
	bool "Auto-register feature_gate module at boot"
	default y

config FEATURE_GATE_LICENSE
	string "Expected license token for premium features"
	default "zeplod-oem-dev"
	help
	  Runtime feature_gate_apply_license() must match this string.

config FEATURE_GATE_BOOT_LICENSE
	string "License applied at init (empty = locked at boot)"
	default ""
	help
	  If non-empty and matches FEATURE_GATE_LICENSE, premium slots start unlocked.

config FEATURE_GATE_SLOT_CLOUD
	bool "Compile cloud feature slot"
	default y

config FEATURE_GATE_SLOT_REMOTE
	bool "Compile remote_diag feature slot"
	default y

endif
```

## src/modules/ipc_service/Kconfig
```kconfig
#
# Copyright (c) 2024 Your Name
#
# SPDX-License-Identifier: Apache-2.0
#

menuconfig IPC_SERVICE
    bool "IPC Service Framework"
    default n
    help
      Enable the IPC Service Framework which provides three invocation modes:
      - SYNC: Blocking call, waits for result
      - ASYNC: Non-blocking call with callback
      - FUTURE: Returns a future object that can be waited on

if IPC_SERVICE

config IPC_SERVICE_MAX_PENDING_REQUESTS
    int "Maximum pending requests"
    default 16
    range 4 64
    help
      Maximum number of pending requests that can be tracked at any time.
      Each pending request consumes memory for tracking state.

config IPC_SERVICE_REQUEST_QUEUE_SIZE
    int "Request queue size"
    default 8
    range 2 32
    help
      Number of requests that can be queued waiting for processing.

config IPC_SERVICE_RESPONSE_QUEUE_SIZE
    int "Response queue size"
    default 8
    range 2 32
    help
      Number of responses that can be queued waiting for dispatch.

config IPC_SERVICE_STACK_SIZE
    int "Service thread stack size"
    default 2048
    range 512 8192
    help
      Stack size for the IPC service thread.

config IPC_SERVICE_PRIORITY
    int "Service thread priority"
    default 5
    range -16 15
    help
      Priority of the IPC service thread. Lower values = higher priority.
      0 is the highest priority for cooperative threads.
      Positive values are for preemptible threads.

config IPC_SERVICE_LOG_LEVEL
    int "Log level"
    default 3
    range 0 4
    help
      Logging level for IPC service:
      0 - OFF
      1 - ERROR
      2 - WARNING
      3 - INFO
      4 - DEBUG

config IPC_SERVICE_EXAMPLE
    bool "Build IPC service example"
    default n
    depends on IPC_SERVICE
    help
      Build the example code demonstrating all three invocation modes.

endif # IPC_SERVICE
```

## src/modules/ota/Kconfig
```kconfig
menuconfig OTA_MODULE
	bool "Enable OTA module"
	default n
	depends on EVENT_MAX_TYPES > 51
	help
	  Firmware OTA state machine with pluggable transport.
	  Requires CONFIG_EVENT_MAX_TYPES > 51 (event IDs 50-51).

if OTA_MODULE

config OTA_MODULE_AUTOINIT
	bool "Auto-register OTA module at boot (SYS_INIT)"
	default y
	help
	  Register ota_module via module_manager at APP_INIT_PRIO_MODULE_OTA.
	  Disable for unit tests that call ota_module_init() manually.

config OTA_MODULE_STACK_SIZE
	int "OTA worker stack size (reserved)"
	default 2048
	range 1024 8192

config OTA_MODULE_PRIORITY
	int "OTA worker thread priority (reserved)"
	default 7
	range 1 15

choice OTA_TRANSPORT
	prompt "OTA transport backend"
	default OTA_TRANSPORT_NULL
	help
	  Null transport uses RAM for native_sim / ztest.
	  MCUboot transport writes to the secondary slot via flash_img.

config OTA_TRANSPORT_NULL
	bool "Null (RAM) transport"

config OTA_TRANSPORT_MCUBOOT
	bool "MCUboot flash_img transport"
	depends on IMG_MANAGER
	help
	  Requires MCUboot partition layout and IMG_MANAGER in board DTS.
	  See conf/targets/mcuboot.conf.

endchoice

config OTA_NULL_TRANSPORT_BUF_SIZE
	int "Null transport simulated image size (bytes)"
	default 4096
	depends on OTA_TRANSPORT_NULL
	help
	  Size of in-RAM image buffer for native_sim tests.

config OTA_EXPECTED_IMAGE_SIZE
	int "Expected max OTA image size (progress denominator)"
	default 4096 if OTA_TRANSPORT_NULL
	default 524288 if OTA_TRANSPORT_MCUBOOT
	help
	  Used to compute download percent when transport has no fixed capacity.

endif
```

## src/modules/provisioning/Kconfig
```kconfig
menuconfig PROVISIONING_MODULE
	bool "Enable provisioning module"
	default n
	depends on EVENT_MAX_TYPES > 61
	help
	  Device identity and provisioning state machine.
	  Requires CONFIG_EVENT_MAX_TYPES > 61 (event ID 61).

if PROVISIONING_MODULE

config PROVISIONING_MODULE_AUTOINIT
	bool "Auto-register provisioning module at boot"
	default y

config PROVISIONING_DEVICE_ID
	string "Device ID string (UUID or serial)"
	default "zeplod-dev-00000001"
	help
	  Exposed via provisioning_module_get_device_id(). Override per SKU in production.

endif
```

## src/modules/recovery/Kconfig
```kconfig
menuconfig RECOVERY_POLICY_MODULE
	bool "Enable recovery policy module"
	default n
	depends on MODULE_MANAGER && EVENT_SYSTEM
	help
	  React to module_manager MODULE_MGR_EVENT_ERROR with graded recovery
	  (restart module, restart all, or system reboot).

if RECOVERY_POLICY_MODULE

config RECOVERY_POLICY_AUTOINIT
	bool "Auto-register recovery policy at boot"
	default y

config RECOVERY_POLICY_MAX_RESTARTS
	int "Max automatic restarts per module before escalation"
	default 3
	range 1 16

config RECOVERY_POLICY_OTA_HOOK
	bool "React to OTA_STATE_ERROR events"
	default y
	depends on OTA_MODULE
	help
	  Subscribe to EVENT_OTA_STATE_CHANGED and run recovery on the OTA
	  module when state becomes OTA_STATE_ERROR.

config RECOVERY_POLICY_WATCHDOG_HOOK
	bool "Register watchdog pre-expire recovery hook"
	default y
	depends on SYS_WATCHDOG_ENABLE
	help
	  On watchdog feed timeout warning, attempt restart_all before reset.

choice RECOVERY_POLICY_DEFAULT_ACTION
	prompt "Default recovery action on module ERROR"
	default RECOVERY_POLICY_ACTION_RESTART_MODULE

config RECOVERY_POLICY_ACTION_NONE
	bool "Log only (no recovery)"

config RECOVERY_POLICY_ACTION_RESTART_MODULE
	bool "Stop and restart failing module"

config RECOVERY_POLICY_ACTION_RESTART_ALL
	bool "Stop all modules and start_all"

config RECOVERY_POLICY_ACTION_REBOOT
	bool "Warm reboot immediately"

endchoice

endif
```

## src/modules/remote_ops/Kconfig
```kconfig
menuconfig REMOTE_OPS_MODULE
	bool "Enable remote operations hooks module"
	default n
	depends on EVENT_SYSTEM
	depends on EVENT_MAX_TYPES > 71
	depends on SYS_DIAG_ENABLE
	help
	  Export sys_diag JSON via pluggable backend (null RAM cache in Phase 5).
	  Event ID 71. mcumgr transport in a future conf/targets overlay.

if REMOTE_OPS_MODULE

config REMOTE_OPS_MODULE_AUTOINIT
	bool "Auto-register remote_ops module at boot"
	default y

choice REMOTE_OPS_BACKEND
	prompt "Remote ops backend"
	default REMOTE_OPS_BACKEND_NULL
	help
	  Null backend caches the last JSON export in RAM for ztest.
	  mcumgr transport can be added in a future conf/targets overlay.

config REMOTE_OPS_BACKEND_NULL
	bool "Null (RAM cache) backend"

endchoice

config REMOTE_OPS_SHELL
	bool "Register remote shell commands"
	default y
	depends on SHELL

config REMOTE_OPS_EXPORT_BUF_SIZE
	int "Max JSON export payload bytes"
	default 384
	range 128 1024

endif
```

## tests/Kconfig
```kconfig
# SPDX-License-Identifier: Apache-2.0
#
# 单元测试应用复用仓库根目录 Kconfig（事件系统、模块管理、IPC 等选项）。

menu "Zeplod unit test options"

config ZTEST_CONCURRENCY_STRESS
	bool "Build concurrency stress ztest suite"
	default n
	depends on ZTEST
	help
	  Multi-thread stress tests allocate static K_THREAD_STACK arrays.
	  Keep disabled for RAM-constrained hardware board test builds;
	  enable via prj_test_extensions.conf on native_sim.

endmenu

rsource "../Kconfig"
```

## west.yml
```yaml
# West manifest file for zephyr_template
# This file is optional - use if you want to manage the project with West

manifest:
  version: 0.13

  remotes:
    - name: zephyrproject
      url-base: https://github.com/zephyrproject-rtos

  projects:
    - name: zephyr
      remote: zephyrproject
      revision: main
      import: true

  self:
    path: .
```
